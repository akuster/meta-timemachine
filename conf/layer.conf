## conf/layer.conf
```bitbake
# We have a conf and classes directory, add to BBPATH
BBPATH .= ":${LAYERDIR}"

# We have recipes-* directories, add to BBFILES
BBFILES += "${LAYERDIR}/recipes-*/*/*.bb \
	${LAYERDIR}/recipes-*/*/*.bbappend"

BBFILE_COLLECTIONS += "timemachine"
BBFILE_PATTERN_timemachine = "^${LAYERDIR}/"
BBFILE_PRIORITY_timemachine = "6"

LAYERDEPENDS_timemachine = "openembedded-layer networking-layer"

TM_HOST_DEV ?= "wlan0"
TM_HOST_NETWORK ?= "192.168.8.0"
TM_HOST_ADDRESS ?= "192.168.8.1"
TM_HOST_NETMASK ?= "255.255.255.000"
TM_HOST_DHCP_START ?= "192.168.8.20"
TM_HOST_DHCP_END ?= "192.168.8.30"
TM_HOST_DHCP_LEASE ?= "12h"
TM_HOST_GW ?= "192.168.8.254"
TM_DOMAIN ?= "example.com"

TM_AP_SSID ?= "Yocto_demo"
TM_AP_HW_MODE ?= "g"
TM_AP_WPA ?= "2"
TM_AP_WPA_PASSPHRASE ?= "montavista"
TM_AP_WPA_KEY_MGMT ?= "WPA-PSK"
```
